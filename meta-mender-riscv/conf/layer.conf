## meta-mender-riscv/conf/layer.conf
```bitbake
# We have a conf and classes directory, add to BBPATH
BBPATH .= ":${LAYERDIR}"

# We have recipes-* directories, add to BBFILES
BBFILES += "${LAYERDIR}/recipes-*/*/*.bb \
            ${LAYERDIR}/recipes-*/*/*.bbappend"

BBFILE_COLLECTIONS += "meta-mender-riscv"
BBFILE_PATTERN_meta-mender-riscv = "^${LAYERDIR}/"
BBFILE_PRIORITY_meta-mender-riscv = "6"

LAYERDEPENDS_meta-mender-riscv = "core"
LAYERSERIES_COMPAT_meta-mender-riscv = "scarthgap"
```
